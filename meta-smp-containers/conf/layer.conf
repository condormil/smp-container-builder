## meta-smp-containers/conf/layer.conf
```bitbake
# We have a conf and classes directory, add to BBPATH
BBPATH =. "${LAYERDIR}:"

# We have a packages directory, add to BBFILES
BBFILES += "${LAYERDIR}/recipes-*/*/*.bb \
            ${LAYERDIR}/recipes-*/*/*.bbappend \
			${LAYERDIR}/recipes-*/*.bb \
			${LAYERDIR}/recipes-*/*.bbappend \
"

BBFILE_COLLECTIONS += "meta-smp-containers"
BBFILE_PATTERN_meta-smp-containers := "^${LAYERDIR}/"
BBFILE_PRIORITY_meta-smp-containers = "50"

# This should only be incremented on significant changes that will
# cause compatibility issues with other layers
LAYERVERSION_meta-smp-containers = "1"
LAYERDEPENDS_meta-smp-containers = "core"
LAYERSERIES_COMPAT_meta-smp-containers = "dunfell"

# Set a variable to get to the top of the metadata location
META_SMP_CONTAINERS = '${@os.path.normpath("${LAYERDIR}/")}'
META_SMP_CONTAINERS[vardepvalue] = "LAYERDIR"
BB_HASHBASE_WHITELIST_append = " META_SMP_CONTAINERS"

SMPC_SIG_KEY ??= "${META_SMP_CONTAINERS}/files/keys/containers.key"
```
